## conf/layer.conf
```bitbake
#
# Copyright (C) 2019 Wind River Systems, Inc.
#

# We have a conf and classes directory, add to BBPATH
BBPATH =. "${LAYERDIR}:"

# We add the *.bbappend to BBFILES. 
BBFILES += "${LAYERDIR}/recipes-*/*/*.bb ${LAYERDIR}/recipes-*/*/*.bbappend"

BBFILE_COLLECTIONS += "wr-nxp-ls1028"
BBFILE_PATTERN_wr-nxp-ls1028 := "^${LAYERDIR}/"
BBFILE_PRIORITY_wr-nxp-ls1028 = "7"

# This should only be incremented on significant changes that will
# cause compatibility issues with other layers
LAYERVERSION_wr-nxp-ls1028 = "1"

LAYERDEPENDS_wr-nxp-ls1028 = "core wrlinux iot-cloud"
LAYERRECOMMENDS_wr-nxp-ls1028 = "nxp-ls1028-dl"

LAYERSERIES_COMPAT_wr-nxp-ls1028 = "thud wrl warrior zeus"
```

## conf/machine/nxp-ls1028.conf
```bitbake
#@TYPE: Machine
#@NAME: nxp-ls1028
#@DESCRIPTION: Machine configuration for NXP QorIQ Layerscape 1028A SoC

DEFAULTTUNE = "cortexa72"
require conf/machine/include/tune-cortexa72.inc

MACHINE_FEATURES = "ext3 pci usbgadget usbhost vfat ext3 serial alsa network screen"

MACHINE_EXTRA_RRECOMMENDS += "linux-firmware-iwlwifi-8265"
MACHINE_EXTRA_RRECOMMENDS += "linux-firmware-iwlwifi-7265d"
MACHINE_EXTRA_RRECOMMENDS += "linux-firmware-ibt-12-16"
MACHINE_EXTRA_RRECOMMENDS += "linux-firmware-ibt-17"


PREFERRED_PROVIDER_virtual/xserver = "xserver-xorg"

XSERVER = "xserver-xorg \
           xserver-xorg-extension-dri \
           xserver-xorg-extension-dri2 \
           xf86-input-mouse \
           xf86-input-keyboard \
           xf86-input-evdev \
           xf86-video-fbdev \
           xf86-video-armsoc \
           xf86-video-modesetting \
           ${@bb.utils.contains('DISTRO_FEATURES', 'opengl', 'mesa mesa-demos', '', d)} \
           matchbox-wm"

KERNEL_IMAGETYPE = "Image"
KERNEL_DEVICETREE = "freescale/fsl-ls1028a-rdb.dtb"

SERIAL_CONSOLES ?= "115200;ttyS0"
SERIAL_CONSOLES_CHECK ?= "${SERIAL_CONSOLES}"

IMAGE_FSTYPES += "tar.bz2"

# multilib support
MULTILIBS ?= "multilib:lib32"
DEFAULTTUNE_virtclass-multilib-lib32 ?= "armv7athf-neon"
EXTRA_IMAGECMD_jffs2 = "--pad --no-cleanmarkers --eraseblock=128"

MACHINE_EXTRA_RRECOMMENDS = " kernel-modules kernel-devicetree"
IMAGE_FSTYPES += "tar.bz2 wic wic.bmap"
IMAGE_TYPEDEP_wic = "tar.bz2"
WKS_FILE ?= "ls1028-sdimage-bootpart.wks"
IMAGE_INSTALL_append = " kernel-devicetree kernel-image-image"
do_image_wic[depends] += "mtools-native:do_populate_sysroot dosfstools-native:do_populate_sysroot"
IMAGE_BOOT_FILES ?= " Image fsl-ls1028a-rdb.dtb"

PREFERRED_PROVIDER_virtual/kernel ??= "linux-yocto"
PREFERRED_VERSION_linux-yocto ?= "5.10%"
BSP_NXP_DERIVED_append_nxp-ls1028 = " nxp-ls1028"

# The loader is flashed into the device separately and not part of the SD image
OSTREE_BOOTLOADER_INCLUDE ?= ""
OSTREE_SD_UBOOT_WIC1 ?= ""
OSTREE_SD_UBOOT_WIC2 ?= ""
OSTREE_SD_UBOOT_WIC3 ?= ""
OSTREE_SD_UBOOT_WIC4 ?= ""

DEFAULT_DTB = "fsl-ls1028a-rdb.dtb"

# Because of the size of boot loader is ~64M and it must be added
# to 64
OSTREE_WKS_EFI_SIZE ?= "--size=128M"
OSTREE_FDISK_FSZ ?= "128"

OSTREE_UBOOT_CMD ?= "booti"
INITRAMFS_IMAGE ??= ""
IMAGE_BOOT_FILES_append = " \
    ${@bb.utils.contains('DISTRO_FEATURES', 'ostree', 'boot.scr', '', d)} \
    ${@bb.utils.contains('DISTRO_FEATURES', 'ostree', '${INITRAMFS_IMAGE}-${MACHINE}.${INITRAMFS_FSTYPES};initramfs', '', d)} \
"
OSTREE_KERNEL ?= "Image"
OSTREE_COPY_IMAGE_BOOT_FILES = "1"
OSTREE_BOOTSCR_PRECMD ?= "\
setenv loadaddr \${kernel_addr_r}; \
setenv initrd_addr \${ramdisk_addr_r}; \
setenv fdt_addr \${fdt_addr_r}; \
setenv no_menu yes; \
setenv console ttyS0; \
setenv no_fatwrite yes; \
"

# For ustart.img
OSTREE_NETINST_DEV ?= "/dev/mmcblk0,/dev/sda,/dev/vda"
OSTREE_NETINST_ARGS ?= " \
    ${OSTREE_CONSOLE} bl=ufsd rdinit=/install \
    instdev=${OSTREE_NETINST_DEV} instname=wrlinux \
    instbr=\$BRANCH insturl=\$URL instab=${OSTREE_USE_AB} \
    instsf=1 instdate=BUILD_DATE \
"
```
